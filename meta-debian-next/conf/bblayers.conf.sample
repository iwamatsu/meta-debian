## meta-debian-next/conf/bblayers.conf.sample
```bitbake
# POKY_BBLAYERS_CONF_VERSION is increased each time build/conf/bblayers.conf
# changes incompatibly
POKY_BBLAYERS_CONF_VERSION = "2"

BBPATH = "${TOPDIR}"
BBFILES ?= ""

# TODO: consider adding OE-Core (meta)
BBLAYERS ?= " \
  ##OEROOT##/nneta-elbe \
  ##OEROOT##/meta-debian/meta-debian-next \
  "
```

## meta-debian-next/conf/distro/buster.conf
```bitbake
# based on stretch.conf of ELBE

DISTRO = "buster"
DISTRO_NAME = "Debian (buster)"
DISTRO_VERSION = "10.0"
DISTRO_CODENAME = "buster"

SDK_VENDOR = "-elbe"
SDK_VERSION := "${@'${DISTRO_VERSION}'.replace('snapshot-${DATE}','snapshot')}"

LOCALCONF_VERSION = "1"

MIRRORS =+ "\
ftp://.*/.*      http://downloads.yoctoproject.org/mirror/sources/ \n \
http://.*/.*     http://downloads.yoctoproject.org/mirror/sources/ \n \
https://.*/.*    http://downloads.yoctoproject.org/mirror/sources/ \n"

# OELAYOUT_ABI allows us to notify users when the format of TMPDIR changes in 
# an incompatible way. Such changes should usually be detailed in the commit
# that breaks the format and have been previously discussed on the mailing list 
# with general agreement from the core team.
#
OELAYOUT_ABI = "11"

# restore variables in bitbake.conf
TARGET_ARCH = "${TUNE_ARCH}"
TARGET_OS = "linux${LIBCEXTENSION}${ABIEXTENSION}"
PACKAGE_ARCH = "${TUNE_PKGARCH}"

# set to empty (same as Debian)
TARGET_VENDOR = ""
TOOLCHAIN_OPTIONS = ""

# in poky, tclibc-glibc.inc provides this
LIBCEXTENSION = "${@['', '-gnu'][(d.getVar('ABIEXTENSION') or '') != '']}"

DEBIAN_MIRROR ?= "http://ftp.debian.org/debian"
```

## meta-debian-next/conf/layer.conf
```bitbake
# We have a conf and classes directory, add to BBPATH
BBPATH .= ":${LAYERDIR}"

# We have recipes-* directories, add to BBFILES
BBFILES += "${LAYERDIR}/recipes-*/*/*.bb"

BBFILE_COLLECTIONS += "debian-next"
BBFILE_PATTERN_debian-next = "^${LAYERDIR}/"
BBFILE_PRIORITY_debian-next = "6"

# TBD
export http_proxy = "http://proxy.rdc.toshiba.co.jp:8080"
export https_proxy = "http://proxy.rdc.toshiba.co.jp:8080"
```

## meta-debian-next/conf/local.conf.sample
```bitbake
MACHINE = "armhf"
DISTRO = "buster"
DL_DIR = "${TOPDIR}/downloads"
CONF_VERSION = "1"
```

## meta-debian-next/conf/machine/armhf.conf
```bitbake
# in poky, defined by include/arm/arch-arm.inc
# required to set HOST_PREFIX to Debian's (arm-linux-gnueabihf)
TUNE_ARCH = "arm"
ABIEXTENSION = "eabihf"

# architecture name in Debian
DEB_ARCH = "armhf"

# in poky, defined in include/arm/arch-arm.inc and related
# FIXME: temporally set to dummy value because of
# complexity of the original definition
TUNE_PKGARCH = "arm"
```
